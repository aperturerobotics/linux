## arch/wasm/Kconfig
```kconfig
# SPDX-License-Identifier: GPL-2.0-only

menu "Wasm-specific options"

config WASM
	bool
	default y
	select ARCH_NO_PREEMPT
	select THREAD_INFO_IN_TASK
	select NO_IP
	select UACCESS_MEMCPY
	select GENERIC_CPU_DEVICES
	select GENERIC_ENTRY
	select GENERIC_IRQ_SHOW
	select HAVE_SYSCALL_TRACEPOINTS
	select ARCH_USE_BUILTIN_BSWAP
	select GENERIC_ATOMIC64
	select SPARSE_IRQ
	select OF_EARLY_FLATTREE if OF
	select ARCH_32BIT_OFF_T

config MMU
	bool
	default n

config GENERIC_HWEIGHT
	def_bool y

config GENERIC_CSUM
	def_bool y

config NO_IOPORT_MAP
	def_bool y

config HZ
	int
	default 100

config NR_IRQS
	int
	default 32

endmenu
```

## arch/wasm/configs/wasm_defconfig
```kconfig
# Minimal WASI reactor kernel config
CONFIG_PREEMPT_NONE=y
CONFIG_CC_OPTIMIZE_FOR_SIZE=y
CONFIG_EMBEDDED=y
CONFIG_EXPERT=y
CONFIG_PRINTK=y
CONFIG_BLK_DEV_INITRD=y
CONFIG_INITRAMFS_SOURCE="arch/wasm/initramfs.list"
CONFIG_PROC_FS=y
CONFIG_SYSFS=y
CONFIG_TMPFS=y
CONFIG_MODULES=n
CONFIG_NETWORKING=n
CONFIG_BLOCK=n
CONFIG_DEBUG_KERNEL=n
CONFIG_SMP=n
CONFIG_RANDSTRUCT_NONE=y
```

## fs/v86fs/Kconfig
```kconfig
# SPDX-License-Identifier: GPL-2.0-only
config V86_FS
	bool "v86 Host Filesystem (v86fs)"
	depends on VIRTIO
	help
	  v86fs provides a high-performance filesystem for v86 emulated
	  guests, using a custom virtio device to access host filesystem
	  handles directly via DMA.

	  If unsure, say N.
```
